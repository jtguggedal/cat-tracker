## Kconfig
```kconfig
#
# Copyright (c) 2019-2020 Nordic Semiconductor ASA
#
# SPDX-License-Identifier: LicenseRef-BSD-5-Clause-Nordic
#

menu "Cat Tracker application"

config CAT_TRACKER_APP_VERSION
	string "The version of the cat tracker firmware"
	default "0.0.0-development"

rsource "src/events/Kconfig"
rsource "src/managers/Kconfig"
rsource "src/watchdog/Kconfig"

endmenu

menu "Zephyr Kernel"
source "Kconfig.zephyr"
endmenu

module = CAT_TRACKER
module-str = Cat Tracker
source "subsys/logging/Kconfig.template.log_config"
```

## src/cloud/cloud_codec/Kconfig
```kconfig
#
# Copyright (c) 2020 Nordic Semiconductor
#
# SPDX-License-Identifier: LicenseRef-BSD-5-Clause-Nordic
#

menuconfig CLOUD_CODEC
	bool "Cloud codec and ringbuffer"
	select CJSON_LIB if AZURE_IOT_HUB || AWS_IOT || NRF_CLOUD
	default y

if CLOUD_CODEC

config GPS_BUFFER_MAX
	int "GPS data ringbuffer entries"
	default 20

config SENSOR_BUFFER_MAX
	int "Sensor data ringbuffer entries"
	default 20

config MODEM_BUFFER_MAX
	int "Modem data ringbuffer entries"
	default 20

config UI_BUFFER_MAX
	int "UI data ringbuffer entries"
	default 20

config ACCEL_BUFFER_MAX
	int "Accelerometer data ringbuffer entries"
	default 20

config BAT_BUFFER_MAX
	int "Battery data ringbuffer entries"
	default 20

config TIME_BETWEEN_ACCELEROMETER_BUFFER_STORE_SEC
	int "Accelerometer data ringbuffer storage interval"
	default 10
	help
	  How often a store can occur to the accelerometer ringbuffer.

endif # CLOUD_CODEC

module = CLOUD_CODEC
module-str = Cloud codec
source "subsys/logging/Kconfig.template.log_config"
```

## src/ext_sensors/Kconfig
```kconfig
#
# Copyright (c) 2020 Nordic Semiconductor
#
# SPDX-License-Identifier: LicenseRef-BSD-5-Clause-Nordic
#

menuconfig EXTERNAL_SENSORS
	bool "External sensors"

if EXTERNAL_SENSORS

config ACCELEROMETER_DEV_NAME
	string "Accelerometer device name"

config MULTISENSOR_DEV_NAME
	string "Multisensor device name"

endif # EXTERNAL_SENSORS

module = EXTERNAL_SENSORS
module-str = External sensors
source "subsys/logging/Kconfig.template.log_config"
```

## src/modules/Kconfig
```kconfig
#
# Copyright (c) 2020 Nordic Semiconductor
#
# SPDX-License-Identifier: LicenseRef-BSD-5-Clause-Nordic
#

menu "GPS module"

config GPS_MODULE
	bool ""
	default y

if GPS_MODULE

config GPSTHREAD_STACK_SIZE
	int ""
	default 1024

config GPS_DEV_NAME
	string "GPS device name"
	default "NRF9160_GPS"

endif

endmenu # GPS module

menu "Modem module"

config MODEM_MODULE
	bool
	default y

if MODEM_MODULE

config MODEMAUTO_REQUEST_POWER_SAVING_FEATURES
	bool "Request LTE power saving features when establishing a LTE link"
	default y

config MODEMTHREAD_STACK_SIZE
	int ""
	default 1024

config EXPECTED_MODEM_FIRMWARE_VERSION
	string "The expected modem firmware version"
	default "mfw_nrf9160_1.2.2"

endif

endmenu # Modem module

menu "Cloud module"

config CLOUD_MODULE
	bool ""
	default y

if CLOUD_MODULE

config CLOUDTHREAD_STACK_SIZE
	int ""
	default 6000

config USE_CUSTOM_MQTT_CLIENT_ID
	bool "Use custom MQTT client ID"
	help
	  By default the device's IMEI is used as the client ID
	  for the MQTT connection. This allows to use a fixed
	  value instead. This is mostly useful when providing
	  firmware builds to continuous integration tests on
	  real hardware.
	  Note: you must only run this firmware build on one
	  device at a time.

config MQTT_CLIENT_ID
	depends on USE_CUSTOM_MQTT_CLIENT_ID
	string	"Configures the custom MQTT client ID"
	default "yoghurt"

config CLOUD_CONNECT_RETRIES
	int "Number of times the device will try to reconnect to cloud"
	default 10

endif

endmenu # Cloud module

menu "UI module"

config UI_MODULE
	bool ""
	default y

if UI_MODULE

config UITHREAD_STACK_SIZE
	int ""
	default 256

endif

endmenu # UI module

menu "OUTPUT module"

config OUTPUT_MODULE
	bool ""
	select USE_UI_MODULE
	default y

if OUTPUT_MODULE

config OUTPUTTHREAD_STACK_SIZE
	int ""
	default 512

rsource "../ui/Kconfig"

endif

endmenu # OUTPUT module

menu "Data module"

config DATA_MODULE
	bool ""
	default y

if DATA_MODULE

config DATATHREAD_STACK_SIZE
	int ""
	default 2048

rsource "../cloud/cloud_codec/Kconfig"

endif

endmenu # Data module

menu "Sensor module"

config SENSOR_MODULE
	bool ""
	default y

if SENSOR_MODULE

config SENSORTHREAD_STACK_SIZE
	int ""
	default 1024

rsource "../ext_sensors/Kconfig"

endif

endmenu # Sensor module

menu "Utility module"

config UTIL_MODULE
	bool ""
	default y

if UTIL_MODULE

config UTILTHREAD_STACK_SIZE
	int ""
	default 1024

config REBOOT_TIMEOUT
	int "Sets the time from a fatal error or reboot request to reboot"
	default 30
	help
	  This option specifies the timeout that the utility module will
	  initiate a reboot regardless if the other modules has reported
	  that they are ready for a reboot or not.

endif

endmenu # Utility module
```

## src/modules/Kconfig.data_module
```kconfig
#
# Copyright (c) 2020 Nordic Semiconductor
#
# SPDX-License-Identifier: LicenseRef-BSD-5-Clause-Nordic
#

menuconfig DATA_MODULE
	bool "Data module"
	default y

if DATA_MODULE

config DATA_THREAD_STACK_SIZE
	int "Data module thread stack size"
	default 2048

rsource "../cloud/cloud_codec/Kconfig"

endif # DATA_MODULE

module = DATA_MODULE
module-str = Data module
source "subsys/logging/Kconfig.template.log_config"
```

## src/modules/Kconfig.output_module
```kconfig
#
# Copyright (c) 2020 Nordic Semiconductor
#
# SPDX-License-Identifier: LicenseRef-BSD-5-Clause-Nordic
#

menuconfig OUTPUT_MODULE
	bool "Output module"
	select LED_CONTROL
	default y

if OUTPUT_MODULE

config OUTPUT_THREAD_STACK_SIZE
	int "Output module thread stack size"
	default 512

rsource "../led/Kconfig"

endif # OUTPUT_MODULE

module = OUTPUT_MODULE
module-str = Output module
source "subsys/logging/Kconfig.template.log_config"
```

## src/modules/Kconfig.ui_module
```kconfig
#
# Copyright (c) 2020 Nordic Semiconductor
#
# SPDX-License-Identifier: LicenseRef-BSD-5-Clause-Nordic
#

menuconfig UI_MODULE
	bool "User Interface module"
	select DK_LIBRARY
	default y

if UI_MODULE

endif # UI_MODULE

module = UI_MODULE
module-str = User Interface module
source "subsys/logging/Kconfig.template.log_config"
```

## src/ui/Kconfig
```kconfig
#
# Copyright (c) 2019-2020 Nordic Semiconductor ASA
#
# SPDX-License-Identifier: LicenseRef-BSD-5-Clause-Nordic
#

menuconfig USE_UI_MODULE
	bool "LED module"

if USE_UI_MODULE

config UI_LED_USE_PWM
	bool "Use PWM to control LEDs"
	default y if BOARD_THINGY91_NRF9160NS
	select PWM if BOARD_THINGY91_NRF9160NS
	select PWM_0 if BOARD_THINGY91_NRF9160NS

if UI_LED_USE_PWM

config UI_LED_PWM_DEV_NAME
	string "PWM device name for RGB LED"
	default "PWM_0" if BOARD_THINGY91_NRF9160NS

config UI_LED_RED_PIN
	int "Red LED pin number"
	default 29 if BOARD_THINGY91_NRF9160NS

config UI_LED_GREEN_PIN
	int "Green LED pin number"
	default 30 if BOARD_THINGY91_NRF9160NS

config UI_LED_BLUE_PIN
	int "Blue LED pin number"
	default 31 if BOARD_THINGY91_NRF9160NS

endif # UI_LED_USE_PWM

endif # USE_UI_MODULE

module = UI
module-str = User Interface
source "subsys/logging/Kconfig.template.log_config"
```
